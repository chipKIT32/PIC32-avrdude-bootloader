#include <xc.h>
#include <stdint.h>

#include "logo.h"

#define F_CPU 200000000
#define CORE_TIMER_TICKS_PER_MILLISECOND    ((F_CPU + 1000) / 2000)

//void __attribute__((weak)) hook_init() {}
//void __attribute__((weak)) hook_cmd_sign_on() {}
//void __attribute__((weak)) hook_cmd_set_baud() {}
//void __attribute__((weak)) hook_cmd_set_parameter() {}
//void __attribute__((weak)) hook_cmd_get_parameter() {}
//void __attribute__((weak)) hook_cmd_enter_progmode_isp() {}
//void __attribute__((weak)) hook_cmd_spi_multi() {}
//void __attribute__((weak)) hook_cmd_chip_erase_isp() {}
//void __attribute__((weak)) hook_cmd_load_address() {}
//void __attribute__((weak)) hook_cmd_program_flash_isp() {}
//void __attribute__((weak)) hook_cmd_read_flash_isp() {}
//void __attribute__((weak)) hook_cmd_leave_progmode_isp() {}


static const uint8_t DefaultFont[] = {
    0x00, 0x00, 0x00, 0x00, 0x00, 0x00, 0x00, 0x00, 
    0x0E, 0x1F, 0x15, 0x1F, 0x1B, 0x11, 0x0E, 0x00, 
    0x0E, 0x1F, 0x15, 0x1F, 0x11, 0x1B, 0x0E, 0x00, 
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    0x00, 0x00, 0x00, 0x00, 0x00, 0x00, 0x00, 0x00,
};

static uint32_t millis() {
    return _CP0_GET_COUNT() / CORE_TIMER_TICKS_PER_MILLISECOND;
}

static void delay(uint32_t ms) {
    uint32_t start = millis();
    while (millis() - start < ms);
}

static void command(uint16_t c) {
    while (PMMODEbits.BUSY == 1);
    PMADDR = 0x0000;
    PMDIN = c;
}

static void data(uint16_t c) {
    while (PMMODEbits.BUSY == 1);
    PMADDR = 0x0001;
    PMDIN = c;
}

static void setAddrWindow(int x0, int y0, int x1, int y1) {
    command(0x2a);
    data(x0 >> 8);
    data(x0 & 0xff);
    data(x1 >> 8);
    data(x1 & 0xff);

    command(0x2b);
    data(y0 >> 8);
    data(y0 & 0xff);
    data(y1 >> 8);
    data(y1 & 0xff);

    command(0x2c);
}

static int cx = 0;
static int cy = 0;
static uint16_t cbg = 0;
static uint16_t cfg = 0xFFFF;

static void putChar(int x, int y, char c, uint16_t bg, uint16_t fg) {
    const uint8_t *ptr = DefaultFont + (c * 8);
    uint8_t line = 0;
    uint8_t pix = 0;
    setAddrWindow(x, y, x+5, y+7);
    for (line = 0; line < 8; line++) {
        for (pix = 0; pix < 6; pix++) {
            if (ptr[line] & (1 << pix)) {
                data(fg);
            } else {
                data(bg);
            }
        }
    }
}

static void writeChar(char c) {
    putChar(cx, cy, c, cbg, cfg);
    cx += 6;
    if (cx >= 320) {
        cx = 0;
        cy += 8;
    }
}

static void printString(const char *c) {
    while (*c) {
        writeChar(*c);
        c++;
    }
}

/* ------------ HOOKS ------------ */

int hook_init() {
    // Back light off
    TRISFbits.TRISF8 = 0;
    LATFbits.LATF8 = 0;

    // Hold screen in reset
    TRISCbits.TRISC13 = 0;
    LATCbits.LATC13 = 0;

    // Screen not selected
    TRISAbits.TRISA2 = 1;
    LATAbits.LATA2 = 1;

    // Init PMP
    PMCONbits.ON = 0;
    asm volatile("nop");

    PMCONbits.PTWREN = 1;
    PMCONbits.PTRDEN = 1;
    PMCONbits.CSF = 0;

    PMAEN = 0x0001; // Enable PMA0 pin for RS pin and CS1 as CS

    PMMODEbits.MODE16 = 1;
    PMMODEbits.MODE = 0b10;
    PMMODEbits.WAITB = 0x0;
    PMMODEbits.WAITM = 0x0;
    PMMODEbits.WAITE = 0x0;

    //PMADDR = 0; // Set current address to 0
    PMADDR = 0x0000; // Set current address to 0, CS1 Active

    PMCONbits.ON = 1;

    // Configure screen

    LATCbits.LATC13 = 1;  // RESET High

    uint32_t tStart = _CP0_GET_COUNT();
    delay(100);

    LATAbits.LATA2 = 0; // CS Low

    command(0xc8);
    data(0xFF);
    data(0x93);
    data(0x42);


    command(0x36);       //Memory Access Control
    data(0xc8);//MY,MX,MV,ML,BGR,MH


    command(0x3A);       //Pixel Format Set
    data(0x55);//DPI [2:0],DBI [2:0]

    command(0xC0);  // Power control
    data(0x10);     // Iffy
    data(0x10);     // Plain wrong?

    command(0xC1);
    data(0x36);

    command(0xC5);     //VCOM
    data(0xC3);

    command(0xE0);    //Set Gamma
    data(0x00);
    data(0x05);
    data(0x08);
    data(0x02);
    data(0x1A);
    data(0x0C);
    data(0x42);
    data(0X7A);
    data(0x54);
    data(0x08);
    data(0x0D);
    data(0x0C);
    data(0x23);
    data(0x25);
    data(0x0F);

    command(0XE1);    //Set Gamma
    data(0x00);
    data(0x29);
    data(0x2F);
    data(0x03);
    data(0x0F);
    data(0x05);
    data(0x42);
    data(0x55);
    data(0x53);
    data(0x06);
    data(0x0F);
    data(0x0C);
    data(0x38);
    data(0x3A);
    data(0x0F);

    command(0x11);//Exit Sleep
    delay(100);
    command(0x29);//Display On

    setAddrWindow(0, 0, 320, 240);
    int x;
    for (x = 0; x < 320*240; x++) {
        data(0);
    }
    return -1;
}


int hook_cmd_sign_on() {
    setAddrWindow(0, 0, 320, 240);
    int x;
    for (x = 0; x < 320*240; x++) {
        data(0);
    }

    LATFbits.LATF8 = 1; // Backlight on

    setAddrWindow(19, 30 , 19 + 282, 30+72);
    for (x = 0; x < 283 * 73; x++) {
        data(logo[x]);
    }

    cx = 110;
    cy = 20;
    printString("Bootloader Active");
    return -1;
}

static uint32_t cnt = 0;

static const char hex[16] = {'0', '1', '2', '3', '4', '5', '6', '7', '8', '9', 'A', 'B', 'C', 'D', 'E', 'F'};

int hook_cmd_program_flash_isp(uint32_t a) {

    setAddrWindow(2 + (cnt >> 5), 230, 2 + (cnt >> 5), 239);
    data(0x2000);
    data(0x4000);
    data(0x8000);
    data(0x8000);
    data(0x8000);
    data(0x8000);
    data(0x8000);
    data(0x8000);
    data(0x4000);
    data(0x2000);

    cnt++;

    cx = 130;
    cy = 200;
    printString("0x");
    writeChar(hex[(a >> 28) & 0xf]);
    writeChar(hex[(a >> 24) & 0xf]);
    writeChar(hex[(a >> 20) & 0xf]);
    writeChar(hex[(a >> 16) & 0xf]);
    writeChar(hex[(a >> 12) & 0xf]);
    writeChar(hex[(a >> 8) & 0xf]);
    writeChar(hex[(a >> 4) & 0xf]);
    writeChar(hex[a & 0xf]);

    return -1;

}
